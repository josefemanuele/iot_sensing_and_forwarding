## main/Kconfig.projbuild
```kconfig
menu "Sampling Configuration"

    config BUFFER_SIZE
        int "Buffer size."
        default 100
        help
            Sampling buffer size.

    config MAX_SAMPLE_FREQUENCY
        int "Max sample frequency."
        default 100
        help
            Max sample frequency.
        
endmenu

menu "Aggregation Configuration"

    config AGGREGATION_WINDOW_SIZE
        int "Aggregation window size"
        default 5
        help
            Aggregation window size in seconds.

endmenu

menu "WiFi Configuration"

    config ESP_WIFI_SSID
        string "WiFi SSID"
        default "myssid"
        help
            SSID (network name) for the example to connect to.

    config ESP_WIFI_PASSWORD
        string "WiFi Password"
        default "mypassword"
        help
            WiFi password (WPA or WPA2) for the example to use.

    config ESP_MAXIMUM_RETRY
        int "Maximum retry"
        default 3
        help
            Set the Maximum retry to avoid station reconnecting to the AP unlimited when the AP is really inexistent.

    choice ESP_WIFI_SCAN_AUTH_MODE_THRESHOLD
        prompt "WiFi Scan auth mode threshold"
        default ESP_WIFI_AUTH_WPA2_PSK
        help
            The weakest authmode to accept in the scan mode.
            This value defaults to ESP_WIFI_AUTH_WPA2_PSK incase password is present and ESP_WIFI_AUTH_OPEN is used.
            Please select ESP_WIFI_AUTH_WEP/ESP_WIFI_AUTH_WPA_PSK incase AP is operating in WEP/WPA mode.

        config ESP_WIFI_AUTH_OPEN
            bool "OPEN"
        config ESP_WIFI_AUTH_WPA2_PSK
            bool "WPA2 PSK"
    endchoice

endmenu

menu "MQTT Configuration"

    config MQTT_BROKER_URI
        string "MQTT broker uri"
        default "mqtts://localhost:8883"
        help
            URI for mqtts broker connection

    config MQTT_TOPIC
        string "MQTT topic"
        default "/measurements"
        help
            Topic to use for MQTT connection

endmenu
```
